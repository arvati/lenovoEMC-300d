## Drivers/gpio-f7188x/src/Kconfig
```kconfig
config GPIO_F7188X
	tristate "F71808E and F71869, F71869A, F71882FG, F71889F, F81866 GPIO support"
	help
	  This option enables support for GPIOs found on Fintek Super-I/O
	  chips F71808E and F71869, F71869A, F71882FG, F71889F, F81866.
```

## Network/apache2/Config.in
```kconfig
menu "Configuration"
        depends on PACKAGE_apache2

config APACHE2_LUA
        bool "Enable LUA"
        help
              Provides Lua hooks into various portions of the httpd request processing.
        default y

config APACHE2_HTTP2
        bool "Enable HTTP2"
        help
                Enable HTTPS2 support.
        default y

config APACHE2_DAV
        bool "Enable DAV"
        help
                Enable Distributed Authoring and Versioning (WebDAV) functionality support and Filesystem provider.
        default y


config APACHE2_PROXY
        bool "Enable PROXY Extension"
        help
                Enable Multi-protocol proxy/gateway server support for several extensions.
        default y

config APACHE2_SESSION
        bool "Enable SESSION"
        help
                Enable Session support.
        default y


config APACHE2_AUTH
        bool "Enable AUTH"
        help
                Enable Auth support.
        default y

config APACHE2_VHOST
        bool "Enable VHOST"
        help
                Enable VHOST support.
        default y

endmenu
```

## f71808e/src/Kconfig
```kconfig
config SENSORS_F71808E
	tristate "Fintek F71808E"
	depends on EXPERIMENTAL
	help
	  If you say yes here you get support for hardware monitoring
	  features of the Fintek F71808E
	  Super-I/O chips.

	  This driver can also be built as a module.  If so, the module
	  will be called f71805f.
```

## f75383/src/Kconfig
```kconfig
config SENSORS_F75383
	tristate "Fintek F75383"
	depends on I2C
	default y
	help
	  If you say yes here you get support for hardware monitoring
	  features of the Fintek F75383
	  Sensor chips.

	  This driver can also be built as a module.
```

## f75393/src/Kconfig
```kconfig
config SENSORS_F75393
	tristate "Fintek F75393"
	depends on I2C
	default y
	help
	  If you say yes here you get support for hardware monitoring
	  features of the Fintek F75393
	  Sensor chips.

	  This driver can also be built as a module.
```

## gpio-f7188x/src/Kconfig
```kconfig
config GPIO_F7188X
	tristate "F71882FG and F71889F GPIO support"
	depends on X86
	help
	  This option enables support for GPIOs found on Fintek Super-I/O
	  chips F71882FG and F71889F.

	  To compile this driver as a module, choose M here: the module will
	  be called f7188x-gpio.
```

## ich9-gpio/src/Kconfig
```kconfig
config GPIO_ICH9
	tristate "Intel ICH9R GPIO"
	help
	  GPIO Driver for Intel ICH9R.
```

## lpc-ich/src/Kconfig
```kconfig
config LPC_ICH
	tristate "Intel ICH LPC"
	depends on PCI
	select MFD_CORE
	help
	  The LPC bridge function of the Intel ICH provides support for
	  many functional units. This driver provides needed support for
	  other drivers to control these functions, currently GPIO and
	  watchdog.
```

## naswake/src/Kconfig
```kconfig
config NASWAKE
	tristate "NAS Wake Function"
	depends on GPIO_ICH
	help
	  This driver is for NAS WOL function.
```

## pca9538/src/Kconfig
```kconfig
config GPIO_PCA9538
	tristate "PCA9538 for NAS HWMONITOR"
	depends on GPIO_ICH9 && I2C
	help
	  If you say yes here you get support for hwardware monitoring (HDD detect)
	  features on PCA9538

	  This driver can also be built as a module.  If so, the module
	  will be called f71805f.
```

## pega-btn/src/Kconfig
```kconfig
config PEGA_NAS_BUTTON
	tristate "Button Driver for NAS system "
	depends on GPIO_ICH
	default m
	help
	  Enable this driver to support button.
```

## ums8485md/src/Kconfig
```kconfig
config LCD_UMS8485MD
	tristate "UMS-8485MD-B Driver"
	depends on GPIO_ICH && SENSORS_F71882FG
	default m
	help
	  If you have an UMS-8485MD-B LCD Module say Y to enable a driver
	  for its LCD.
```
